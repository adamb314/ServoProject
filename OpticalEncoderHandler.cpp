#include "OpticalEncoderHandler.h"

uint16_t debugValue = 0;

uint16_t OpticalEncoderHandler::getDebugValue()
{
    return debugValue;
}

OpticalEncoderHandler::OpticalEncoderHandler(const std::array<uint16_t, 512>& aVec, const std::array<uint16_t, 512>& bVec) :
    aVec(aVec), bVec(bVec), sensor1(A2), sensor2(A3), value(0), wrapAroundCorretion(0), newData(false)
{
}

OpticalEncoderHandler::~OpticalEncoderHandler()
{
}

void OpticalEncoderHandler::init()
{
    AdcHandler::init();

    triggerSample();
    getValue();
}

void OpticalEncoderHandler::triggerSample()
{
    sensor1.triggerSample();
    sensor2.triggerSample();

    newData = true;
}

float OpticalEncoderHandler::getValue()
{
    if (newData)
    {
        newData = false;
        updatePosition();
    }

    return (value + wrapAroundCorretion);
}

//uint16_t aVec[] = {3395, 3383, 3367, 3357, 3353, 3350, 3350, 3357, 3358, 3345, 3340, 3332, 3326,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 3410, 3404};
//uint16_t bVec[] = {2785, 2797, 2802, 2797, 2797, 2795, 2797, 2795, 2798, 2809, 2822, 2834, 2838,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 2769, 2781};

//uint16_t aVec[] = {991, 997, 1002, 1006, 1014, 1019, 1024, 1031, 1042, 1048, 1054, 1059, 1063,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 986, 989};
//uint16_t bVec[] = {1036, 1070, 1110, 1152, 1194, 1226, 1262, 1319, 1360, 1396, 1434, 1460, 1497,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 974, 999};
//
//constexpr int vecSize = sizeof(aVec) / sizeof(aVec[0]);

void OpticalEncoderHandler::updatePosition()
{
    uint16_t start = micros();

    uint16_t a = sensor1.getValue();
    uint16_t b = sensor2.getValue();

    int stepSize = static_cast<int>(aVec.size() / 2.0 + 1);

    int i = 0;
    uint32_t cost = calcCost(i, a, b);

    int bestI = i;
    uint32_t bestCost = cost;

    i += stepSize;
    while (i < aVec.size())
    {
        cost = calcCost(i, a, b);

        if (cost < bestCost)
        {
            bestI = i;
            bestCost = cost;
        }

        i += stepSize;
    }

    int checkDir = 1;

    while (stepSize != 1)
    {
        i = bestI;

        stepSize = stepSize / 2;
        if (stepSize == 0)
        {
            stepSize = 1;
        }

        i += stepSize * checkDir;

        cost = calcCost(i, a, b);

        if (cost < bestCost)
        {
            bestI = i;
            bestCost = cost;

            checkDir *= -1;

            continue;
        }

        i -= 2 * stepSize * checkDir;

        cost = calcCost(i, a, b);

        if (cost < bestCost)
        {
            bestI = i;
            bestCost = cost;
        }
    }

    debugValue = micros() - start;

    float newValue = bestI * (4096.0 / aVec.size());

    if (newValue - value > 4096 / 2)
    {
        wrapAroundCorretion -= 4096;
    }
    else if (newValue - value < -4096 / 2)
    {
        wrapAroundCorretion += 4096;
    }

    value = newValue;
}

uint32_t OpticalEncoderHandler::calcCost(int& i, uint16_t a, uint16_t b)
{
    if (i >= aVec.size())
    {
        i -= aVec.size();
    }
    else if (i < 0)
    {
        i += aVec.size();
    }

    uint32_t tempA;
    tempA = aVec[i] - a;
    tempA = tempA * tempA;

    uint32_t tempB;
    tempB = bVec[i] - b;
    tempB = tempB * tempB;

    return tempA + tempB;
}
